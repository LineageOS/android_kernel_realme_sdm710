## drivers/input/touchscreen/oppo_touchscreen/Kconfig
```kconfig
config TOUCHIRQ_UPDATE_QOS
	bool "OPPO touchpanel driver update qos"
	help
	  Say Y here if you want to update qos value in irq handler.

config TOUCHPANEL_OPPO
	bool "OPPO tp module"
	help
	  Say Y here if you have touchscreen module.

config TOUCHPANEL_MULTI_NOFLASH
	bool "Multiple noflash TPs using"
	help
	  Say Y here if you have multiple noflash touchscreen.

config TOUCHPANEL_HIMAX
	bool "TP HIMAX_IC enable or not for OPPO"
	---help---
	say Y to enable driver for Touchpanel using HIMAX_IC

if TOUCHPANEL_HIMAX
source "drivers/input/touchscreen/oppo_touchscreen/Himax/Kconfig"
endif
```

## drivers/platform/realme/Kconfig
```kconfig
config MACH_REALME
       bool "realme device"

config MACH_REALME_SDM710
       bool "realme sdm710"
       select MACH_REALME
       depends on ARCH_SDM670

config MACH_REALME_RMX1851
       bool "realme 3 Pro"
       select MACH_REALME_SDM710
```
